## os/pi-trustee/meta-pi-trustee/conf/distro/pi-trustee-distro.conf
```bitbake
require conf/distro/poky.conf

DISTRO = "pi-trustee-distro"
DISTRO_VERSION = "1.0"

IMAGE_FSTYPES = "wic.bz2 wic.bmap"

DISTRO_FEATURES:append = " virtualization systemd systemd-compat-units usrmerge k3s seccomp"
DISTRO_FEATURES:remove = "sysvinit opengl wayland vulkan x11 3g nfc pulseaudio bluez5"
VIRTUAL-RUNTIME_init_manager = "systemd"
DISTRO_FEATURES_OPTED_OUT = "sysvinit"
VIRTUAL-RUNTIME_initscripts = "systemd-compat-units"
```
